## sdkconfig.defaults
```kconfig
# FreeRTOS tick rate for better LVGL timer precision
CONFIG_FREERTOS_HZ=1000

# PSRAM configuration for ESP32-P4
CONFIG_SPIRAM=y
# SPI-RAM mode/speed already set in sdkconfig (HEX / 200M)
CONFIG_SPIRAM_XIP_FROM_PSRAM=y
CONFIG_SPIRAM_USE_CAPS_ALLOC=y
CONFIG_SPIRAM_TRY_ALLOCATE_WIFI_LWIP=y

# DPI frame buffer count (1 = min PSRAM bandwidth)
CONFIG_BSP_LCD_DPI_BUFFER_NUMS=1

# L2 Cache for ESP32-P4 performance
CONFIG_CACHE_L2_CACHE_256KB=y
CONFIG_CACHE_L2_CACHE_LINE_128B=y

# Compiler optimizations
CONFIG_COMPILER_OPTIMIZATION_PERF=y

# LVGL configuration
CONFIG_LV_OS_FREERTOS=y
CONFIG_LV_USE_CLIB_MALLOC=y
CONFIG_LV_USE_CLIB_STRING=y
CONFIG_LV_USE_CLIB_SPRINTF=y
CONFIG_LV_DEF_REFR_PERIOD=15
CONFIG_LV_OBJ_STYLE_CACHE=y

# Multi-core rendering (ESP32-P4 dual-core)
CONFIG_LV_DRAW_SW_DRAW_UNIT_CNT=2

# LVGL memory pool (reduce default to save PSRAM)
CONFIG_LV_MEM_SIZE_KILOBYTES=256

# LVGL built-in fonts (enable sizes we use)
CONFIG_LV_FONT_MONTSERRAT_24=y

# LVGL v9 adapter uses ESP_MAIN_TASK_STACK_SIZE instead
# Increase for image preprocessing + model inference stack usage
CONFIG_ESP_MAIN_TASK_STACK_SIZE=16384
CONFIG_MAIN_TASK_STACK_SIZE=16384

# esp_video: enable MIPI-CSI video device (/dev/video0)
CONFIG_ESP_VIDEO_ENABLE_MIPI_CSI_VIDEO_DEVICE=y

# OV5647: customize IPA JSON (AGC brightness fix)
CONFIG_CAMERA_OV5647_CUSTOMIZED_IPA_JSON_CONFIGURATION_FILE=y
CONFIG_CAMERA_OV5647_CUSTOMIZED_IPA_JSON_CONFIGURATION_FILE_PATH="main/camera/ov5647_default.json"
```
